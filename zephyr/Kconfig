## zephyr/Kconfig
```kconfig
#
#   Copyright (c) 2021 Entropic Engineering
#
#   Licensed under the Apache License, Version 2.0 (the "License");
#   you may not use this file except in compliance with the License.
#   You may obtain a copy of the License at
#
#       http://www.apache.org/licenses/LICENSE-2.0
#
#   Unless required by applicable law or agreed to in writing, software
#   distributed under the License is distributed on an "AS IS" BASIS,
#   WITHOUT WARRANTIES OR CONDITIONS OF ANY KIND, either express or implied.
#   See the License for the specific language governing permissions and
#   limitations under the License.
#

menuconfig LUA
	bool "Enable Lua"
	default n

if LUA

module = LUA
module-str = lua
source "subsys/logging/Kconfig.template.log_config"

config APP_LINK_WITH_LUA
    bool "Link 'app' with Lua"
    default y
    help
        Add Lua header files to the 'app' include path. It may be
        disabled if the include paths for Lua are causing aliasing
        issues for 'app'.

choice
    prompt "Select mode of implementing LUAI_THROW"
    default LUA_EXCEPTION_IMPLEMENTATION_GCC_LONGJMP

    config LUA_EXCEPTION_IMPLEMENTATION_PANIC
        bool "Panic"
        help
            Implement exceptions with a stub that just calls abort().
            Minimal compiler support needed, but will mean many lua errors
            turn into a call to abort() and are unrecoverable.

    config LUA_EXCEPTION_IMPLEMENTATION_GCC_LONGJMP
        bool "GCC intrinsic longjmp"
        help
            Implement exceptions via the gcc longjmp intrinsic.
            Provided the compiler supports it, will behave correctly.
endchoice

config LUA_ENABLE_LOAD_BINARY
    bool "Allow lua to load (and store) binary chunks"
    default y

config LUA_ENABLE_LOAD_STRING
    bool "Allow lua to load string chunks"
    default y

config LUA_ENABLE_FS
    bool "Implement lua filesystem routines via Zephyr VFS"
    default n
    depends on FILE_SYSTEM
    depends on LUA_UNIMPLEMENTED

config LUA_ENABLE_AUXLIB
    bool "Enable lauxlib (almost always wanted)"
    default y

config LUA_ENABLE_CONSOLE_OUTPUT
    bool "Enable lua console output (i.e. print)"
    default y

config LUA_ENABLE_CONSOLE_INPUT
    bool "Enable console input (i.e. interactivity)"
    default n
    depends on LUA_UNIMPLEMENTED

config LUA_ENABLE_LIB_BASE
    bool "Enable lua base library"
    default y
    depends on LUA_ENABLE_AUXLIB

menu "Lua library support"
    depends on LUA_ENABLE_LIB_BASE

    config LUA_ENABLE_LIB_DEBUG
        bool "Enable lua debug library"
        default n
        help
            This is probably not that useful without LUA_ENABLE_CONSOLE_INPUT

    config LUA_ENABLE_LIB_COROUTINE
        bool "Enable lua coroutine library"
        default n
        depends on LUA_UNIMPLEMENTED

    config LUA_ENABLE_LIB_PACKAGE
        bool "Enable lua package (module-loading) library"
        default n
        depends on LUA_ENABLE_FS
        depends on LUA_UNIMPLEMENTED

    config LUA_ENABLE_LIB_TABLE
        bool "Enable lua table manipulation library"
        default n

    config LUA_ENABLE_RANDOMIZE_PIVOTS
        bool "Randomize table pivot operations"
        default n
        depends on LUA_ENABLE_LIB_TABLE
        help
            Might improve the performance of tablib's quicksort in some cases.
            Disabled by default to increase determinism.

    config LUA_ENABLE_LIB_IO
        bool "Enable lua io library"
        default n
        depends on LUA_ENABLE_FS
        depends on LUA_UNIMPLEMENTED

    config LUA_ENABLE_LIB_OS
        bool "Enable lua os library"
        default n
        depends on LUA_ENABLE_FS
        depends on LUA_UNIMPLEMENTED

    config LUA_ENABLE_LIB_STRING
        bool "Enable lua string library"
        default n

    config LUA_ENABLE_LIB_MATH
        bool "Enable lua math library"
        default n

    config LUA_ENABLE_MATH_TRUE_RANDOM
        bool "Use zephyr's randomness facility (sys_rand32_get, NOT cryptographic) to feed the math lib rng instead of time"
        default n
        depends on LUA_ENABLE_LIB_MATH
        depends on RNG_GENERATOR_CHOICE

    config LUA_ENABLE_LIB_UTF8
        bool "Enable lua utf8 library"
        default n
        depends on LUA_UNIMPLEMENTED
endmenu

menu "Lua internal settings"
    config LUA_LOCALE_DECPOINT
        string "Lua floating point decimal symbol"
        default "."

    config LUA_ENABLE_RANDOMIZE_HASHES
        bool "Randomize hash values in the lua interpreter"
        default n
        help
            This is only relevant to avoid tarpit attacks where malicious input
            hits high-complexity cases in e.g. table lookup. Irrelevant for most
            MCU applications, disabled by default to increase determinism.

endmenu

endif # LUA
```
